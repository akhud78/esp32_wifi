## Kconfig
```kconfig
menu "Wi-Fi Station Configuration"

	config WIFI_STA_SSID
	    string "Wi-Fi SSID"
	    default "wireless"
	    help
		SSID (network name) for the example to connect to.

	config WIFI_STA_PASSWORD
	    string "Wi-Fi Password"
	    default "password"
	    help
		Wi-Fi password (WPA or WPA2) for the example to use.
		Can be left blank if the network has no security set.

	config WIFI_STA_MAXIMUM_RETRY
	    int "Maximum retry"
	    default 2
	    help
		Set the Maximum retry to avoid station reconnecting to the AP unlimited when the AP is really inexistent.

	config WIFI_STA_TIME_RETRY
	    int "Connection Retry Period (s)"
	    default 60

	config WIFI_STATIC
	    bool "Use static IP"

	config WIFI_STATIC_IP
	    depends on WIFI_STATIC
	    string "IP address"
	    default "192.168.1.22"	    
	   
	config WIFI_STATIC_GW
	    depends on WIFI_STATIC
	    string "Gateway"
	    default "192.168.1.1"

	config WIFI_STATIC_MASK
	    depends on WIFI_STATIC
	    string "Mask"
	    default "255.255.255.0"

endmenu

menu "Wi-Fi Access Point Configuration"

	config WIFI_AP_SSID
		string "Wi-Fi SSID"
		default "wireless"
		help
		    SSID (network name) for the example to connect to.

	config WIFI_AP_PASSWORD
		string "Wi-Fi Password"
		default "password"
		help
		    Wi-Fi password (WPA or WPA2) for the example to use.

	config WIFI_AP_CHANNEL
		int "Wi-Fi Channel"
		range 1 13
		default 1
		help
		    Wi-Fi channel (network channel) for the example to use.

	config WIFI_AP_MAX_STA_CONN
		int "Maximal STA connections"
		default 4
		help
		    Max number of the STA connects to AP.

endmenu
```
